/*
 * Custom Glove80 keymap - Stock layout with minimal productivity mods
 *
 * Based on official MoErgo Glove80 default layout
 * 
 * Modifications:
 * - A = tap 'a', hold = Select All (Ctrl+A)
 * - S = tap 's', hold = Save (Ctrl+S)
 * - D = tap 'd', hold = Duplicate line (Ctrl+D)
 * - F = tap 'f', hold = Find (Ctrl+F)
 * - Z/X/C/V/Y = tap letter, hold = Undo/Cut/Copy/Paste/Redo
 * - Enter = tap Enter, hold Save (Ctrl+S)
 * - Backspace = tap Backspace, hold = Delete word backward (Ctrl+Backspace)
 * - Hyphen/Minus = tap hyphen, double-tap = en dash (–), hold = em dash (—)
 * - Tab and Esc positions swapped
 * - Esc = tap Esc, hold = toggle Caps Lock
 * - Tab = tap Tab, hold = Windows+Tab (Task View)
 * - Left+Right arrows = Select word (Ctrl+Shift+Right)
 * - Up+Down arrows = Select section (Ctrl+Shift+Down)
 * - Left+Home = Start of document (Ctrl+Home)
 * - Right+End = End of document (Ctrl+End)
 * - Shifts = normal shift (reverted from caps lock tap)
 * - Space unchanged (plain space)
 * - All other layers kept as stock
 *
 * SPDX-License-Identifier: MIT
 */

#include <behaviors.dtsi>
#include <dt-bindings/zmk/keys.h>
#include <dt-bindings/zmk/bt.h>
#include <dt-bindings/zmk/ext_power.h>
#include <dt-bindings/zmk/outputs.h>
#include <dt-bindings/zmk/rgb.h>

#define HYPER LC(LS(LG(LALT)))

// layers
#define DEFAULT 0
#define LOWER 1
#define MAGIC 2
#define FACTORY_TEST 3

/ {
    behaviors {
        // Stock layer tap dance
        layer_td: tap_dance_0 {
            compatible = "zmk,behavior-tap-dance";
            label = "LAYER_TAP_DANCE";
            #binding-cells = <0>;
            tapping-term-ms = <200>;
            bindings = <&mo LOWER>, <&to LOWER>;
        };

        // Stock magic behavior
        magic: magic_hold_tap {
            compatible = "zmk,behavior-hold-tap";
            label = "MAGIC_HOLD_TAP";
            #binding-cells = <2>;
            flavor = "tap-preferred";
            tapping-term-ms = <200>;
            bindings = <&mo>, <&rgb_ug_status_macro>;
        };

        // CUSTOM: Esc / Caps Lock Toggle
        esc_caps_ht: esc_caps_hold_tap {
            compatible = "zmk,behavior-hold-tap";
            label = "ESC_CAPS_HT";
            #binding-cells = <2>;
            flavor = "tap-preferred";
            tapping-term-ms = <280>;
            require-prior-idle-ms = <150>;
            bindings = <&kp>, <&kp>;
        };

        // CUSTOM: Tab / Windows+Tab (Task View)
        tab_taskview_ht: tab_taskview_hold_tap {
            compatible = "zmk,behavior-hold-tap";
            label = "TAB_TASKVIEW_HT";
            #binding-cells = <2>;
            flavor = "tap-preferred";
            tapping-term-ms = <350>;
            require-prior-idle-ms = <150>;
            bindings = <&taskview>, <&kp>;
        };

        // CUSTOM: S / Save
        s_save_ht: s_save_hold_tap {
            compatible = "zmk,behavior-hold-tap";
            label = "S_SAVE_HT";
            #binding-cells = <2>;
            flavor = "tap-preferred";
            tapping-term-ms = <280>;
            require-prior-idle-ms = <150>;
            bindings = <&save>, <&kp>;
        };

        // CUSTOM: F / Find
        f_find_ht: f_find_hold_tap {
            compatible = "zmk,behavior-hold-tap";
            label = "F_FIND_HT";
            #binding-cells = <2>;
            flavor = "tap-preferred";
            tapping-term-ms = <280>;
            require-prior-idle-ms = <150>;
            bindings = <&find>, <&kp>;
        };

        // CUSTOM: D / Duplicate
        d_duplicate_ht: d_duplicate_hold_tap {
            compatible = "zmk,behavior-hold-tap";
            label = "D_DUPLICATE_HT";
            #binding-cells = <2>;
            flavor = "tap-preferred";
            tapping-term-ms = <280>;
            require-prior-idle-ms = <150>;
            bindings = <&duplicate>, <&kp>;
        };

        // CUSTOM: Backspace / Delete Word
        bspc_delword_ht: bspc_delword_hold_tap {
            compatible = "zmk,behavior-hold-tap";
            label = "BSPC_DELWORD_HT";
            #binding-cells = <2>;
            flavor = "tap-preferred";
            tapping-term-ms = <280>;
            require-prior-idle-ms = <150>;
            bindings = <&delword>, <&kp>;
        };

        // CUSTOM: Left Shift / Caps Lock
        lsft_caps_ht: lsft_caps_hold_tap {
            compatible = "zmk,behavior-hold-tap";
            label = "LSFT_CAPS_HT";
            #binding-cells = <2>;
            flavor = "hold-preferred";
            tapping-term-ms = <280>;
            require-prior-idle-ms = <150>;
            bindings = <&kp>, <&kp>;
        };

        // CUSTOM: Right Shift / Caps Lock
        rsft_caps_ht: rsft_caps_hold_tap {
            compatible = "zmk,behavior-hold-tap";
            label = "RSFT_CAPS_HT";
            #binding-cells = <2>;
            flavor = "hold-preferred";
            tapping-term-ms = <280>;
            require-prior-idle-ms = <150>;
            bindings = <&kp>, <&kp>;
        };

        // CUSTOM: Left Shift / Caps Lock
        lsft_caps_ht: lsft_caps_hold_tap {
            compatible = "zmk,behavior-hold-tap";
            label = "LSFT_CAPS_HT";
            #binding-cells = <2>;
            flavor = "hold-preferred";
            tapping-term-ms = <280>;
            require-prior-idle-ms = <150>;
            bindings = <&kp>, <&kp>;
        };

        // CUSTOM: Right Shift / Caps Lock
        rsft_caps_ht: rsft_caps_hold_tap {
            compatible = "zmk,behavior-hold-tap";
            label = "RSFT_CAPS_HT";
            #binding-cells = <2>;
            flavor = "hold-preferred";
            tapping-term-ms = <280>;
            require-prior-idle-ms = <150>;
            bindings = <&kp>, <&kp>;
        };

        // CUSTOM: Enter / Save
        enter_save_ht: enter_save_hold_tap {
            compatible = "zmk,behavior-hold-tap";
            label = "ENTER_SAVE_HT";
            #binding-cells = <2>;
            flavor = "tap-preferred";
            tapping-term-ms = <280>;
            require-prior-idle-ms = <150>;
            bindings = <&save>, <&kp>;
        };

        // CUSTOM: Z / Undo
        z_undo_ht: z_undo_hold_tap {
            compatible = "zmk,behavior-hold-tap";
            label = "Z_UNDO_HT";
            #binding-cells = <2>;
            flavor = "tap-preferred";
            tapping-term-ms = <280>;
            require-prior-idle-ms = <150>;
            bindings = <&undo>, <&kp>;
        };

        // CUSTOM: X / Cut
        x_cut_ht: x_cut_hold_tap {
            compatible = "zmk,behavior-hold-tap";
            label = "X_CUT_HT";
            #binding-cells = <2>;
            flavor = "tap-preferred";
            tapping-term-ms = <280>;
            require-prior-idle-ms = <150>;
            bindings = <&cut>, <&kp>;
        };

        // CUSTOM: C / Copy
        c_copy_ht: c_copy_hold_tap {
            compatible = "zmk,behavior-hold-tap";
            label = "C_COPY_HT";
            #binding-cells = <2>;
            flavor = "tap-preferred";
            tapping-term-ms = <280>;
            require-prior-idle-ms = <150>;
            bindings = <&copy>, <&kp>;
        };

        // CUSTOM: V / Paste
        v_paste_ht: v_paste_hold_tap {
            compatible = "zmk,behavior-hold-tap";
            label = "V_PASTE_HT";
            #binding-cells = <2>;
            flavor = "tap-preferred";
            tapping-term-ms = <280>;
            require-prior-idle-ms = <150>;
            bindings = <&paste>, <&kp>;
        };

        // CUSTOM: Y / Redo
        y_redo_ht: y_redo_hold_tap {
            compatible = "zmk,behavior-hold-tap";
            label = "Y_REDO_HT";
            #binding-cells = <2>;
            flavor = "balanced";
            tapping-term-ms = <300>;
            quick-tap-ms = <175>;
            require-prior-idle-ms = <150>;
            bindings = <&redo>, <&kp>;
        };

        // CUSTOM: A / Select All
        a_selectall_ht: a_selectall_hold_tap {
            compatible = "zmk,behavior-hold-tap";
            label = "A_SELECTALL_HT";
            #binding-cells = <2>;
            flavor = "tap-preferred";
            tapping-term-ms = <280>;
            require-prior-idle-ms = <150>;
            bindings = <&selectall>, <&kp>;
        };

        // CUSTOM: Hyphen / Em dash with tap dance for En dash
        hyphen_dash: hyphen_dash_behavior {
            compatible = "zmk,behavior-hold-tap";
            label = "HYPHEN_DASH";
            #binding-cells = <2>;
            flavor = "tap-preferred";
            tapping-term-ms = <280>;
            require-prior-idle-ms = <150>;
            bindings = <&emdash>, <&hyphen_td>;
        };

        // Tap dance: single tap = hyphen, double tap = en dash
        hyphen_td: hyphen_tap_dance {
            compatible = "zmk,behavior-tap-dance";
            label = "HYPHEN_TAP_DANCE";
            #binding-cells = <0>;
            tapping-term-ms = <200>;
            bindings = <&kp MINUS>, <&endash>;
        };
    };

    macros {
        // Stock RGB macro
        rgb_ug_status_macro: rgb_ug_status_macro_0 {
            label = "RGB_UG_STATUS";
            compatible = "zmk,behavior-macro";
            #binding-cells = <0>;
            bindings = <&rgb_ug RGB_STATUS>;
        };

        // Stock Bluetooth profiles
        bt_0: bt_profile_macro_0 {
            label = "BT_0";
            compatible = "zmk,behavior-macro";
            #binding-cells = <0>;
            bindings = <&out OUT_BLE>, <&bt BT_SEL 0>;
        };

        bt_1: bt_profile_macro_1 {
            label = "BT_1";
            compatible = "zmk,behavior-macro";
            #binding-cells = <0>;
            bindings = <&out OUT_BLE>, <&bt BT_SEL 1>;
        };

        bt_2: bt_profile_macro_2 {
            label = "BT_2";
            compatible = "zmk,behavior-macro";
            #binding-cells = <0>;
            bindings = <&out OUT_BLE>, <&bt BT_SEL 2>;
        };

        bt_3: bt_profile_macro_3 {
            label = "BT_3";
            compatible = "zmk,behavior-macro";
            #binding-cells = <0>;
            bindings = <&out OUT_BLE>, <&bt BT_SEL 3>;
        };

        // CUSTOM: Productivity macros
        save: save_macro {
            compatible = "zmk,behavior-macro";
            label = "SAVE";
            #binding-cells = <0>;
            bindings = <&macro_press &kp LCTRL>, <&macro_tap &kp S>, <&macro_release &kp LCTRL>;
        };

        undo: undo_macro {
            compatible = "zmk,behavior-macro";
            label = "UNDO";
            #binding-cells = <0>;
            bindings = <&macro_press &kp LCTRL>, <&macro_tap &kp Z>, <&macro_release &kp LCTRL>;
        };

        cut: cut_macro {
            compatible = "zmk,behavior-macro";
            label = "CUT";
            #binding-cells = <0>;
            bindings = <&macro_press &kp LCTRL>, <&macro_tap &kp X>, <&macro_release &kp LCTRL>;
        };

        copy: copy_macro {
            compatible = "zmk,behavior-macro";
            label = "COPY";
            #binding-cells = <0>;
            bindings = <&macro_press &kp LCTRL>, <&macro_tap &kp C>, <&macro_release &kp LCTRL>;
        };

        paste: paste_macro {
            compatible = "zmk,behavior-macro";
            label = "PASTE";
            #binding-cells = <0>;
            bindings = <&macro_press &kp LCTRL>, <&macro_tap &kp V>, <&macro_release &kp LCTRL>;
        };

        redo: redo_macro {
            compatible = "zmk,behavior-macro";
            label = "REDO";
            #binding-cells = <0>;
            bindings = <&macro_press &kp LCTRL>, <&macro_tap &kp Y>, <&macro_release &kp LCTRL>;
        };

        selectall: selectall_macro {
            compatible = "zmk,behavior-macro";
            label = "SELECTALL";
            #binding-cells = <0>;
            bindings = <&macro_press &kp LCTRL>, <&macro_tap &kp A>, <&macro_release &kp LCTRL>;
        };

        // CUSTOM: Arrow key combos for text selection
        select_word: select_word_macro {
            compatible = "zmk,behavior-macro";
            label = "SELECT_WORD";
            #binding-cells = <0>;
            bindings = <&macro_press &kp LCTRL &kp LSHFT>, <&macro_tap &kp RIGHT>, <&macro_release &kp LCTRL &kp LSHFT>;
        };

        select_section: select_section_macro {
            compatible = "zmk,behavior-macro";
            label = "SELECT_SECTION";
            #binding-cells = <0>;
            bindings = <&macro_press &kp LCTRL &kp LSHFT>, <&macro_tap &kp DOWN>, <&macro_release &kp LCTRL &kp LSHFT>;
        };

        // CUSTOM: Windows+Tab for Task View
        taskview: taskview_macro {
            compatible = "zmk,behavior-macro";
            label = "TASKVIEW";
            #binding-cells = <0>;
            bindings = <&macro_press &kp LGUI>, <&macro_tap &kp TAB>, <&macro_release &kp LGUI>;
        };

        // CUSTOM: Find (Ctrl+F)
        find: find_macro {
            compatible = "zmk,behavior-macro";
            label = "FIND";
            #binding-cells = <0>;
            bindings = <&macro_press &kp LCTRL>, <&macro_tap &kp F>, <&macro_release &kp LCTRL>;
        };

        // CUSTOM: Duplicate line (Ctrl+D)
        duplicate: duplicate_macro {
            compatible = "zmk,behavior-macro";
            label = "DUPLICATE";
            #binding-cells = <0>;
            bindings = <&macro_press &kp LCTRL>, <&macro_tap &kp D>, <&macro_release &kp LCTRL>;
        };

        // CUSTOM: Delete word backward (Ctrl+Backspace)
        delword: delword_macro {
            compatible = "zmk,behavior-macro";
            label = "DELWORD";
            #binding-cells = <0>;
            bindings = <&macro_press &kp LCTRL>, <&macro_tap &kp BSPC>, <&macro_release &kp LCTRL>;
        };

        // CUSTOM: Go to start of document (Ctrl+Home)
        doc_start: doc_start_macro {
            compatible = "zmk,behavior-macro";
            label = "DOC_START";
            #binding-cells = <0>;
            bindings = <&macro_press &kp LCTRL>, <&macro_tap &kp HOME>, <&macro_release &kp LCTRL>;
        };

        // CUSTOM: Go to end of document (Ctrl+End)
        doc_end: doc_end_macro {
            compatible = "zmk,behavior-macro";
            label = "DOC_END";
            #binding-cells = <0>;
            bindings = <&macro_press &kp LCTRL>, <&macro_tap &kp END>, <&macro_release &kp LCTRL>;
        };

        // CUSTOM: Em dash (—)
        emdash: emdash_macro {
            compatible = "zmk,behavior-macro";
            label = "EMDASH";
            #binding-cells = <0>;
            bindings = <&kp LS(LA(MINUS))>;
        };

        // CUSTOM: En dash (–)
        endash: endash_macro {
            compatible = "zmk,behavior-macro";
            label = "ENDASH";
            #binding-cells = <0>;
            bindings = <&kp LA(MINUS)>;
        };
    };

    combos {
        compatible = "zmk,combos";
        
        // Left+Right arrows = Select word
        combo_select_word {
            timeout-ms = <50>;
            key-positions = <73 74>;
            bindings = <&select_word>;
        };
        
        // Up+Down arrows = Select section
        combo_select_section {
            timeout-ms = <50>;
            key-positions = <75 76>;
            bindings = <&select_section>;
        };

        // Left+Home = Start of document
        combo_doc_start {
            timeout-ms = <50>;
            key-positions = <71 73>;
            bindings = <&doc_start>;
        };

        // Right+End = End of document
        combo_doc_end {
            timeout-ms = <50>;
            key-positions = <72 74>;
            bindings = <&doc_end>;
        };
    };

    keymap {
        compatible = "zmk,keymap";

        default_layer {
            // ---------------------------------------------------------------------------------------------------------------------------------
            // |  F1   |  F2 |  F3 |  F4  |  F5  |                                                               |  F6   |  F7   |  F8  |   F9  |  F10 |
            // |  =    |  1  |  2  |  3   |  4   |  5   |                                                 |  6   |   7   |   8   |  9   |   0   |  -/–/—* |
            // |  ESC* |  Q  |  W  |  E   |  R   |  T   |                                                 |  Y*  |   U   |   I   |  O   |   P   |   \  |
            // |  TAB* |  A* |  S* |  D*  |  F*  |  G   |                                                 |  H   |   J   |   K   |  L   |   ;   |   '  |
            // |   `   |  Z* |  X* |  C*  |  V*  |  B   | LSHFT | LCTRL | LOWER | | LGUI  | RCTRL | RSHFT |  N   |   M   |   ,   |  .   |   /   | PGUP |
            // | MAGIC | HOME*|END*|LEFT* |RIGHT*|      | BSPC* | DEL   | LALT  | | RALT  | RET*  | SPACE |      |  UP*  | DOWN* |  [   |   ]   | PGDN |
            // * = MODIFIED from stock
            // ESC* = tap ESC / hold Caps Lock toggle
            // TAB* = tap Tab / hold Windows+Tab (Task View)
            // A* = tap 'a' / hold Select All (Ctrl+A)
            // S* = tap 's' / hold Save (Ctrl+S)
            // D* = tap 'd' / hold Duplicate (Ctrl+D)
            // F* = tap 'f' / hold Find (Ctrl+F)
            // Z/X/C/V/Y* = tap letter / hold Undo/Cut/Copy/Paste/Redo
            // RET* = tap Enter / hold Save (Ctrl+S)
            // BSPC* = tap Backspace / hold Delete word (Ctrl+Backspace)
            // -/–/—* = tap hyphen / double-tap en dash / hold em dash
            // Arrow combos: Left+Right=Select word, Up+Down=Select section
            // Home/End combos: Left+Home=Doc start, Right+End=Doc end

            bindings = <
            &kp F1         &kp F2   &kp F3      &kp F4          &kp F5                                                                                                &kp F6  &kp F7   &kp F8          &kp F9    &kp F10
            &kp EQUAL      &kp N1   &kp N2      &kp N3          &kp N4          &kp N5                                                                        &kp N6  &kp N7   &kp N8          &kp N9    &kp N0     &hyphen_dash 0 0
            &esc_caps_ht CAPSLOCK ESC    &kp Q    &kp W       &kp E           &kp R           &kp T                                                                         &y_redo_ht 0 Y   &kp U    &kp I           &kp O     &kp P      &kp BSLH
            &tab_taskview_ht 0 TAB        &a_selectall_ht 0 A  &s_save_ht 0 S  &d_duplicate_ht 0 D  &f_find_ht 0 F   &kp G                                                                         &kp H   &kp J    &kp K           &kp L     &kp SEMI   &kp SQT
            &kp GRAVE      &z_undo_ht 0 Z       &x_cut_ht 0 X   &c_copy_ht 0 C  &v_paste_ht 0 V &kp B   &kp LSHFT &kp LCTRL &layer_td   &kp LGUI  &kp RCTRL &kp RSHFT &kp N   &kp M    &kp COMMA       &kp DOT   &kp FSLH   &kp PG_UP
            &magic MAGIC 0 &kp HOME &kp END     &kp LEFT        &kp RIGHT               &bspc_delword_ht 0 BSPC  &kp DEL   &kp LALT    &kp RALT  &enter_save_ht 0 RET &kp SPACE        &kp UP   &kp DOWN        &kp LBKT  &kp RBKT   &kp PG_DN
            >;
        };

        lower_layer {
            // ---------------------------------------------------------------------------------------------------------------------------------
            // | BTCLR | BT1 | BT2 |  BT3 |  BT4 |                                                                |      |      |      |      |      |
            // |  F11  |  F1 |  F2 |  F3  |  F4  |  F5  |                                                   |  F6  |  F7  |  F8  |  F9  | F10  |  F12 |
            // |   `   |  1  |  2  |  3   |  4   |  5   |                                                   |  6   |  7   |  8   |  9   |  0   |      |
            // |       |  !  |  @  |  #   |  $   |  %   |                                                   |  ^   |  &   |  *   |  (   |  )   |      |
            // |       |  =  |  -  |  +   |  {   |  }   |        |      |      |      |      |      |      |  [   |  ]   |  ;   |  :   |  \   |      |
            // |       |     |     |      |      |              |      |      |      |      |      |      |      |      |      |      |      |      |

            bindings = <
            &bt BT_CLR     &bt BT_SEL 0    &bt BT_SEL 1    &bt BT_SEL 2    &bt BT_SEL 3                                                                                &none &none &none &none &none
            &kp F11        &kp F1          &kp F2          &kp F3          &kp F4          &kp F5                                                          &kp F6    &kp F7    &kp F8          &kp F9    &kp F10   &kp F12
            &kp GRAVE      &kp N1          &kp N2          &kp N3          &kp N4          &kp N5                                                          &kp N6    &kp N7    &kp N8          &kp N9    &kp N0    &trans
            &trans         &kp EXCL        &kp AT          &kp HASH        &kp DOLLAR      &kp PRCNT                                                       &kp CARET &kp AMPS  &kp KP_MULTIPLY &kp LPAR  &kp RPAR  &trans
            &trans         &kp EQUAL       &kp MINUS       &kp KP_PLUS     &kp LBRC        &kp RBRC        &trans &trans &trans        &trans &trans &trans &kp LBKT  &kp RBKT  &kp SEMI        &kp COLON &kp BSLH  &trans
            &trans         &trans          &trans          &trans          &trans                          &trans &trans &trans        &trans &trans &trans           &trans    &trans          &trans    &trans    &trans
            >;
        };

        magic_layer {
            // ---------------------------------------------------------------------------------------------------------------------------------
            // | BTCLR | BT1  | BT2  |  BT3  |  BT4  |                                                                |      |      |      |      | BTCLR|
            // |       |      |      |       |       |       |                                                        |      |      |      |      |      |      |
            // |       | RGB_EFF | RGB_HUI | RGB_SAI | RGB_BRI | RGB_TOG |                                         |      |      |      |      |      |      |
            // | BOOTL | RGB_EFR | RGB_HUD | RGB_SAD | RGB_BRD |         |                                         |      |      |      |      |      | BOOTL|
            // |       |  &bt_2  | &bt_3   |         |         |         |  &bt_2 | &bt_3 |      |      |      |      |      |      |      |      |      |      |
            // |       |         |         |         |         |                  | &bt_0 | &bt_1 | OUT_USB |      |      |      |      |      |      |      |      |

            bindings = <
            &bt BT_CLR        &none           &none           &none           &none                                                                                                           &none &none &none &none &bt BT_CLR_ALL
            &none             &none           &none           &none           &none           &none                                                                                   &none &none &none &none &none &none
            &none             &rgb_ug RGB_EFF &rgb_ug RGB_HUI &rgb_ug RGB_SAI &rgb_ug RGB_BRI &rgb_ug RGB_TOG                                                                         &none &none &none &none &none &none
            &bootloader       &rgb_ug RGB_EFR &rgb_ug RGB_HUD &rgb_ug RGB_SAD &rgb_ug RGB_BRD &none                                                                                   &none &none &none &none &none &bootloader
            &sys_reset        &none           &none           &none           &none           &none           &bt_2   &bt_3         &none               &none &none &none              &none &none &none &none &none &sys_reset
            &none             &none           &none           &none           &none                           &bt_0   &bt_1         &out OUT_USB        &none &none &none                    &none &none &none &none &none
            >;
        };

        factory_test_layer {
            // ---------------------------------------------------------------------------------------------------------------------------------
            // | BTCLR | BT1  | BT2  |  BT3  |  BT4  |                                                                |      |      |      |      | BTCLR|
            // |       |      |      |       |       |       |                                                        |      |      |      |      |      |      |
            // |       |      |      |       |       |       |                                                        |      |      |      |      |      |      |
            // |       |      |      |       |       |       |                                                        |      |      |      |      |      |      |
            // |       |      |      |       |       |       |      |      |      |      |      |      |      |      |      |      |      |      |      |      |
            // |       |      |      |       |       |             |      |      |      |      |      |      |      |      |      |      |      |      |      |

            bindings = <
            &bt BT_CLR &bt BT_SEL 0 &bt BT_SEL 1 &bt BT_SEL 2 &bt BT_SEL 3                                                                           &bt BT_SEL 3 &bt BT_SEL 2 &bt BT_SEL 1 &bt BT_SEL 0 &bt BT_CLR
            &kp F1     &kp F2       &kp F3       &kp F4       &kp F5       &kp F6                                                           &kp F6   &kp F7       &kp F8       &kp F9       &kp F10      &kp F11
            &kp N1     &kp N2       &kp N3       &kp N4       &kp N5       &kp N6                                                           &kp N6   &kp N7       &kp N8       &kp N9       &kp N0       &kp F12
            &kp Q      &kp W        &kp E        &kp R        &kp T        &kp Y                                                            &kp Y    &kp U        &kp I        &kp O        &kp P        &kp BSPC
            &kp A      &kp S        &kp D        &kp F        &kp G        &kp H        &kp LSHFT &kp LCTRL &none        &none &kp RCTRL &kp RSHFT &kp H   &kp J        &kp K        &kp L        &kp SEMI     &kp SQT
            &kp Z      &kp X        &kp C        &kp V        &kp B                     &kp SPACE &kp RET   &none        &none &kp RET   &kp SPACE         &kp N        &kp M        &kp COMMA    &kp DOT      &kp FSLH
            >;
        };
    };
};        // CUSTOM: Tab / Windows+Tab (Task View)
        tab_taskview_ht: tab_taskview_hold_tap {
            compatible = "zmk,behavior-hold-tap";
            label = "TAB_TASKVIEW_HT";
            #binding-cells = <2>;
            flavor = "tap-preferred";
            tapping-term-ms = <350>;
            require-prior-idle-ms = <150>;
            bindings = <&taskview>, <&kp>;
        };

        // CUSTOM: S / Save
        s_save_ht: s_save_hold_tap {
            compatible = "zmk,behavior-hold-tap";
            label = "S_SAVE_HT";
            #binding-cells = <2>;
            flavor = "tap-preferred";
            tapping-term-ms = <280>;
            require-prior-idle-ms = <150>;
            bindings = <&save>, <&kp>;
        };

        // CUSTOM: F / Find
        f_find_ht: f_find_hold_tap {
            compatible = "zmk,behavior-hold-tap";
            label = "F_FIND_HT";
            #binding-cells = <2>;
            flavor = "tap-preferred";
            tapping-term-ms = <280>;
            require-prior-idle-ms = <150>;
            bindings = <&find>, <&kp>;
        };

        // CUSTOM: D / Duplicate
        d_duplicate_ht: d_duplicate_hold_tap {
            compatible = "zmk,behavior-hold-tap";
            label = "D_DUPLICATE_HT";
            #binding-cells = <2>;
            flavor = "tap-preferred";
            tapping-term-ms = <280>;
            require-prior-idle-ms = <150>;
            bindings = <&duplicate>, <&kp>;
        };

        // CUSTOM: Backspace / Delete Word
        bspc_delword_ht: bspc_delword_hold_tap {
            compatible = "zmk,behavior-hold-tap";
            label = "BSPC_DELWORD_HT";
            #binding-cells = <2>;
            flavor = "tap-preferred";
            tapping-term-ms = <280>;
            require-prior-idle-ms = <150>;
            bindings = <&delword>, <&kp>;
        };

        // CUSTOM: Left Shift / Caps Lock
        lsft_caps_ht: lsft_caps_hold_tap {
            compatible = "zmk,behavior-hold-tap";
            label = "LSFT_CAPS_HT";
            #binding-cells = <2>;
            flavor = "hold-preferred";
            tapping-term-ms = <280>;
            require-prior-idle-ms = <150>;
            bindings = <&kp>, <&kp>;
        };

        // CUSTOM: Right Shift / Caps Lock
        rsft_caps_ht: rsft_caps_hold_tap {
            compatible = "zmk,behavior-hold-tap";
            label = "RSFT_CAPS_HT";
            #binding-cells = <2>;
            flavor = "hold-preferred";
            tapping-term-ms = <280>;
            require-prior-idle-ms = <150>;
            bindings = <&kp>, <&kp>;
        };

        // CUSTOM: Left Shift / Caps Lock
        lsft_caps_ht: lsft_caps_hold_tap {
            compatible = "zmk,behavior-hold-tap";
            label = "LSFT_CAPS_HT";
            #binding-cells = <2>;
            flavor = "hold-preferred";
            tapping-term-ms = <280>;
            require-prior-idle-ms = <150>;
            bindings = <&kp>, <&kp>;
        };

        // CUSTOM: Right Shift / Caps Lock
        rsft_caps_ht: rsft_caps_hold_tap {
            compatible = "zmk,behavior-hold-tap";
            label = "RSFT_CAPS_HT";
            #binding-cells = <2>;
            flavor = "hold-preferred";
            tapping-term-ms = <280>;
            require-prior-idle-ms = <150>;
            bindings = <&kp>, <&kp>;
        };

        // CUSTOM: Enter / Save
        enter_save_ht: enter_save_hold_tap {
            compatible = "zmk,behavior-hold-tap";
            label = "ENTER_SAVE_HT";
            #binding-cells = <2>;
            flavor = "tap-preferred";
            tapping-term-ms = <280>;
            require-prior-idle-ms = <150>;
            bindings = <&save>, <&kp>;
        };

        // CUSTOM: Z / Undo
        z_undo_ht: z_undo_hold_tap {
            compatible = "zmk,behavior-hold-tap";
            label = "Z_UNDO_HT";
            #binding-cells = <2>;
            flavor = "tap-preferred";
            tapping-term-ms = <280>;
            require-prior-idle-ms = <150>;
            bindings = <&undo>, <&kp>;
        };

        // CUSTOM: X / Cut
        x_cut_ht: x_cut_hold_tap {
            compatible = "zmk,behavior-hold-tap";
            label = "X_CUT_HT";
            #binding-cells = <2>;
            flavor = "tap-preferred";
            tapping-term-ms = <280>;
            require-prior-idle-ms = <150>;
            bindings = <&cut>, <&kp>;
        };

        // CUSTOM: C / Copy
        c_copy_ht: c_copy_hold_tap {
            compatible = "zmk,behavior-hold-tap";
            label = "C_COPY_HT";
            #binding-cells = <2>;
            flavor = "tap-preferred";
            tapping-term-ms = <280>;
            require-prior-idle-ms = <150>;
            bindings = <&copy>, <&kp>;
        };

        // CUSTOM: V / Paste
        v_paste_ht: v_paste_hold_tap {
            compatible = "zmk,behavior-hold-tap";
            label = "V_PASTE_HT";
            #binding-cells = <2>;
            flavor = "tap-preferred";
            tapping-term-ms = <280>;
            require-prior-idle-ms = <150>;
            bindings = <&paste>, <&kp>;
        };

        // CUSTOM: Y / Redo
        y_redo_ht: y_redo_hold_tap {
            compatible = "zmk,behavior-hold-tap";
            label = "Y_REDO_HT";
            #binding-cells = <2>;
            flavor = "balanced";
            tapping-term-ms = <300>;
            quick-tap-ms = <175>;
            require-prior-idle-ms = <150>;
            bindings = <&redo>, <&kp>;
        };

        // CUSTOM: A / Select All
        a_selectall_ht: a_selectall_hold_tap {
            compatible = "zmk,behavior-hold-tap";
            label = "A_SELECTALL_HT";
            #binding-cells = <2>;
            flavor = "tap-preferred";
            tapping-term-ms = <280>;
            require-prior-idle-ms = <150>;
            bindings = <&selectall>, <&kp>;
        };

        // CUSTOM: Hyphen / Em dash with tap dance for En dash
        hyphen_dash: hyphen_dash_behavior {
            compatible = "zmk,behavior-hold-tap";
            label = "HYPHEN_DASH";
            #binding-cells = <2>;
            flavor = "tap-preferred";
            tapping-term-ms = <280>;
            require-prior-idle-ms = <150>;
            bindings = <&emdash>, <&hyphen_td>;
        };

        // Tap dance: single tap = hyphen, double tap = en dash
        hyphen_td: hyphen_tap_dance {
            compatible = "zmk,behavior-tap-dance";
            label = "HYPHEN_TAP_DANCE";
            #binding-cells = <0>;
            tapping-term-ms = <200>;
            bindings = <&kp MINUS>, <&endash>;
        };
    };

    macros {
        // Stock RGB macro
        rgb_ug_status_macro: rgb_ug_status_macro_0 {
            label = "RGB_UG_STATUS";
            compatible = "zmk,behavior-macro";
            #binding-cells = <0>;
            bindings = <&rgb_ug RGB_STATUS>;
        };

        // Stock Bluetooth profiles
        bt_0: bt_profile_macro_0 {
            label = "BT_0";
            compatible = "zmk,behavior-macro";
            #binding-cells = <0>;
            bindings = <&out OUT_BLE>, <&bt BT_SEL 0>;
        };

        bt_1: bt_profile_macro_1 {
            label = "BT_1";
            compatible = "zmk,behavior-macro";
            #binding-cells = <0>;
            bindings = <&out OUT_BLE>, <&bt BT_SEL 1>;
        };

        bt_2: bt_profile_macro_2 {
            label = "BT_2";
            compatible = "zmk,behavior-macro";
            #binding-cells = <0>;
            bindings = <&out OUT_BLE>, <&bt BT_SEL 2>;
        };

        bt_3: bt_profile_macro_3 {
            label = "BT_3";
            compatible = "zmk,behavior-macro";
            #binding-cells = <0>;
            bindings = <&out OUT_BLE>, <&bt BT_SEL 3>;
        };

        // CUSTOM: Productivity macros
        save: save_macro {
            compatible = "zmk,behavior-macro";
            label = "SAVE";
            #binding-cells = <0>;
            bindings = <&macro_press &kp LCTRL>, <&macro_tap &kp S>, <&macro_release &kp LCTRL>;
        };

        undo: undo_macro {
            compatible = "zmk,behavior-macro";
            label = "UNDO";
            #binding-cells = <0>;
            bindings = <&macro_press &kp LCTRL>, <&macro_tap &kp Z>, <&macro_release &kp LCTRL>;
        };

        cut: cut_macro {
            compatible = "zmk,behavior-macro";
            label = "CUT";
            #binding-cells = <0>;
            bindings = <&macro_press &kp LCTRL>, <&macro_tap &kp X>, <&macro_release &kp LCTRL>;
        };

        copy: copy_macro {
            compatible = "zmk,behavior-macro";
            label = "COPY";
            #binding-cells = <0>;
            bindings = <&macro_press &kp LCTRL>, <&macro_tap &kp C>, <&macro_release &kp LCTRL>;
        };

        paste: paste_macro {
            compatible = "zmk,behavior-macro";
            label = "PASTE";
            #binding-cells = <0>;
            bindings = <&macro_press &kp LCTRL>, <&macro_tap &kp V>, <&macro_release &kp LCTRL>;
        };

        redo: redo_macro {
            compatible = "zmk,behavior-macro";
            label = "REDO";
            #binding-cells = <0>;
            bindings = <&macro_press &kp LCTRL>, <&macro_tap &kp Y>, <&macro_release &kp LCTRL>;
        };

        selectall: selectall_macro {
            compatible = "zmk,behavior-macro";
            label = "SELECTALL";
            #binding-cells = <0>;
            bindings = <&macro_press &kp LCTRL>, <&macro_tap &kp A>, <&macro_release &kp LCTRL>;
        };

        // CUSTOM: Arrow key combos for text selection
        select_word: select_word_macro {
            compatible = "zmk,behavior-macro";
            label = "SELECT_WORD";
            #binding-cells = <0>;
            bindings = <&macro_press &kp LCTRL &kp LSHFT>, <&macro_tap &kp RIGHT>, <&macro_release &kp LCTRL &kp LSHFT>;
        };

        select_section: select_section_macro {
            compatible = "zmk,behavior-macro";
            label = "SELECT_SECTION";
            #binding-cells = <0>;
            bindings = <&macro_press &kp LCTRL &kp LSHFT>, <&macro_tap &kp DOWN>, <&macro_release &kp LCTRL &kp LSHFT>;
        };

        // CUSTOM: Windows+Tab for Task View
        taskview: taskview_macro {
            compatible = "zmk,behavior-macro";
            label = "TASKVIEW";
            #binding-cells = <0>;
            bindings = <&macro_press &kp LGUI>, <&macro_tap &kp TAB>, <&macro_release &kp LGUI>;
        };

        // CUSTOM: Find (Ctrl+F)
        find: find_macro {
            compatible = "zmk,behavior-macro";
            label = "FIND";
            #binding-cells = <0>;
            bindings = <&macro_press &kp LCTRL>, <&macro_tap &kp F>, <&macro_release &kp LCTRL>;
        };

        // CUSTOM: Duplicate line (Ctrl+D)
        duplicate: duplicate_macro {
            compatible = "zmk,behavior-macro";
            label = "DUPLICATE";
            #binding-cells = <0>;
            bindings = <&macro_press &kp LCTRL>, <&macro_tap &kp D>, <&macro_release &kp LCTRL>;
        };

        // CUSTOM: Delete word backward (Ctrl+Backspace)
        delword: delword_macro {
            compatible = "zmk,behavior-macro";
            label = "DELWORD";
            #binding-cells = <0>;
            bindings = <&macro_press &kp LCTRL>, <&macro_tap &kp BSPC>, <&macro_release &kp LCTRL>;
        };

        // CUSTOM: Go to start of document (Ctrl+Home)
        doc_start: doc_start_macro {
            compatible = "zmk,behavior-macro";
            label = "DOC_START";
            #binding-cells = <0>;
            bindings = <&macro_press &kp LCTRL>, <&macro_tap &kp HOME>, <&macro_release &kp LCTRL>;
        };

        // CUSTOM: Go to end of document (Ctrl+End)
        doc_end: doc_end_macro {
            compatible = "zmk,behavior-macro";
            label = "DOC_END";
            #binding-cells = <0>;
            bindings = <&macro_press &kp LCTRL>, <&macro_tap &kp END>, <&macro_release &kp LCTRL>;
        };

        // CUSTOM: Em dash (—)
        emdash: emdash_macro {
            compatible = "zmk,behavior-macro";
            label = "EMDASH";
            #binding-cells = <0>;
            bindings = <&kp LS(LA(MINUS))>;
        };

        // CUSTOM: En dash (–)
        endash: endash_macro {
            compatible = "zmk,behavior-macro";
            label = "ENDASH";
            #binding-cells = <0>;
            bindings = <&kp LA(MINUS)>;
        };
    };

    combos {
        compatible = "zmk,combos";
        
        // Left+Right arrows = Select word
        combo_select_word {
            timeout-ms = <50>;
            key-positions = <73 74>;
            bindings = <&select_word>;
        };
        
        // Up+Down arrows = Select section
        combo_select_section {
            timeout-ms = <50>;
            key-positions = <75 76>;
            bindings = <&select_section>;
        };

        // Left+Home = Start of document
        combo_doc_start {
            timeout-ms = <50>;
            key-positions = <71 73>;
            bindings = <&doc_start>;
        };

        // Right+End = End of document
        combo_doc_end {
            timeout-ms = <50>;
            key-positions = <72 74>;
            bindings = <&doc_end>;
        };
    };

    keymap {
        compatible = "zmk,keymap";

        default_layer {
            // ---------------------------------------------------------------------------------------------------------------------------------
            // |  F1   |  F2 |  F3 |  F4  |  F5  |                                                               |  F6   |  F7   |  F8  |   F9  |  F10 |
            // |  =    |  1  |  2  |  3   |  4   |  5   |                                                 |  6   |   7   |   8   |  9   |   0   |  -/–/—* |
            // |  ESC* |  Q  |  W  |  E   |  R   |  T   |                                                 |  Y*  |   U   |   I   |  O   |   P   |   \  |
            // |  TAB* |  A* |  S* |  D*  |  F*  |  G   |                                                 |  H   |   J   |   K   |  L   |   ;   |   '  |
            // |   `   |  Z* |  X* |  C*  |  V*  |  B   | LSHFT | LCTRL | LOWER | | LGUI  | RCTRL | RSHFT |  N   |   M   |   ,   |  .   |   /   | PGUP |
            // | MAGIC | HOME*|END*|LEFT* |RIGHT*|      | BSPC* | DEL   | LALT  | | RALT  | RET*  | SPACE |      |  UP*  | DOWN* |  [   |   ]   | PGDN |
            // * = MODIFIED from stock
            // ESC* = tap ESC / hold Caps Lock toggle
            // TAB* = tap Tab / hold Windows+Tab (Task View)
            // A* = tap 'a' / hold Select All (Ctrl+A)
            // S* = tap 's' / hold Save (Ctrl+S)
            // D* = tap 'd' / hold Duplicate (Ctrl+D)
            // F* = tap 'f' / hold Find (Ctrl+F)
            // Z/X/C/V/Y* = tap letter / hold Undo/Cut/Copy/Paste/Redo
            // RET* = tap Enter / hold Save (Ctrl+S)
            // BSPC* = tap Backspace / hold Delete word (Ctrl+Backspace)
            // -/–/—* = tap hyphen / double-tap en dash / hold em dash
            // Arrow combos: Left+Right=Select word, Up+Down=Select section
            // Home/End combos: Left+Home=Doc start, Right+End=Doc end

            bindings = <
            &kp F1         &kp F2   &kp F3      &kp F4          &kp F5                                                                                                &kp F6  &kp F7   &kp F8          &kp F9    &kp F10
            &kp EQUAL      &kp N1   &kp N2      &kp N3          &kp N4          &kp N5                                                                        &kp N6  &kp N7   &kp N8          &kp N9    &kp N0     &hyphen_dash 0 0
            &esc_caps_ht CAPSLOCK ESC    &kp Q    &kp W       &kp E           &kp R           &kp T                                                                         &y_redo_ht 0 Y   &kp U    &kp I           &kp O     &kp P      &kp BSLH
            &tab_taskview_ht 0 TAB        &a_selectall_ht 0 A  &s_save_ht 0 S  &d_duplicate_ht 0 D  &f_find_ht 0 F   &kp G                                                                         &kp H   &kp J    &kp K           &kp L     &kp SEMI   &kp SQT
            &kp GRAVE      &z_undo_ht 0 Z       &x_cut_ht 0 X   &c_copy_ht 0 C  &v_paste_ht 0 V &kp B   &kp LSHFT &kp LCTRL &layer_td   &kp LGUI  &kp RCTRL &kp RSHFT &kp N   &kp M    &kp COMMA       &kp DOT   &kp FSLH   &kp PG_UP
            &magic MAGIC 0 &kp HOME &kp END     &kp LEFT        &kp RIGHT               &bspc_delword_ht 0 BSPC  &kp DEL   &kp LALT    &kp RALT  &enter_save_ht 0 RET &kp SPACE        &kp UP   &kp DOWN        &kp LBKT  &kp RBKT   &kp PG_DN
            >;
        };

        lower_layer {
            // ---------------------------------------------------------------------------------------------------------------------------------
            // | BTCLR | BT1 | BT2 |  BT3 |  BT4 |                                                                |      |      |      |      |      |
            // |  F11  |  F1 |  F2 |  F3  |  F4  |  F5  |                                                   |  F6  |  F7  |  F8  |  F9  | F10  |  F12 |
            // |   `   |  1  |  2  |  3   |  4   |  5   |                                                   |  6   |  7   |  8   |  9   |  0   |      |
            // |       |  !  |  @  |  #   |  $   |  %   |                                                   |  ^   |  &   |  *   |  (   |  )   |      |
            // |       |  =  |  -  |  +   |  {   |  }   |        |      |      |      |      |      |      |  [   |  ]   |  ;   |  :   |  \   |      |
            // |       |     |     |      |      |              |      |      |      |      |      |      |      |      |      |      |      |      |

            bindings = <
            &bt BT_CLR     &bt BT_SEL 0    &bt BT_SEL 1    &bt BT_SEL 2    &bt BT_SEL 3                                                                                &none &none &none &none &none
            &kp F11        &kp F1          &kp F2          &kp F3          &kp F4          &kp F5                                                          &kp F6    &kp F7    &kp F8          &kp F9    &kp F10   &kp F12
            &kp GRAVE      &kp N1          &kp N2          &kp N3          &kp N4          &kp N5                                                          &kp N6    &kp N7    &kp N8          &kp N9    &kp N0    &trans
            &trans         &kp EXCL        &kp AT          &kp HASH        &kp DOLLAR      &kp PRCNT                                                       &kp CARET &kp AMPS  &kp KP_MULTIPLY &kp LPAR  &kp RPAR  &trans
            &trans         &kp EQUAL       &kp MINUS       &kp KP_PLUS     &kp LBRC        &kp RBRC        &trans &trans &trans        &trans &trans &trans &kp LBKT  &kp RBKT  &kp SEMI        &kp COLON &kp BSLH  &trans
            &trans         &trans          &trans          &trans          &trans                          &trans &trans &trans        &trans &trans &trans           &trans    &trans          &trans    &trans    &trans
            >;
        };

        magic_layer {
            // ---------------------------------------------------------------------------------------------------------------------------------
            // | BTCLR | BT1  | BT2  |  BT3  |  BT4  |                                                                |      |      |      |      | BTCLR|
            // |       |      |      |       |       |       |                                                        |      |      |      |      |      |      |
            // |       | RGB_EFF | RGB_HUI | RGB_SAI | RGB_BRI | RGB_TOG |                                         |      |      |      |      |      |      |
            // | BOOTL | RGB_EFR | RGB_HUD | RGB_SAD | RGB_BRD |         |                                         |      |      |      |      |      | BOOTL|
            // |       |  &bt_2  | &bt_3   |         |         |         |  &bt_2 | &bt_3 |      |      |      |      |      |      |      |      |      |      |
            // |       |         |         |         |         |                  | &bt_0 | &bt_1 | OUT_USB |      |      |      |      |      |      |      |      |

            bindings = <
            &bt BT_CLR        &none           &none           &none           &none                                                                                                           &none &none &none &none &bt BT_CLR_ALL
            &none             &none           &none           &none           &none           &none                                                                                   &none &none &none &none &none &none
            &none             &rgb_ug RGB_EFF &rgb_ug RGB_HUI &rgb_ug RGB_SAI &rgb_ug RGB_BRI &rgb_ug RGB_TOG                                                                         &none &none &none &none &none &none
            &bootloader       &rgb_ug RGB_EFR &rgb_ug RGB_HUD &rgb_ug RGB_SAD &rgb_ug RGB_BRD &none                                                                                   &none &none &none &none &none &bootloader
            &sys_reset        &none           &none           &none           &none           &none           &bt_2   &bt_3         &none               &none &none &none              &none &none &none &none &none &sys_reset
            &none             &none           &none           &none           &none                           &bt_0   &bt_1         &out OUT_USB        &none &none &none                    &none &none &none &none &none
            >;
        };

        factory_test_layer {
            // ---------------------------------------------------------------------------------------------------------------------------------
            // | BTCLR | BT1  | BT2  |  BT3  |  BT4  |                                                                |      |      |      |      | BTCLR|
            // |       |      |      |       |       |       |                                                        |      |      |      |      |      |      |
            // |       |      |      |       |       |       |                                                        |      |      |      |      |      |      |
            // |       |      |      |       |       |       |                                                        |      |      |      |      |      |      |
            // |       |      |      |       |       |       |      |      |      |      |      |      |      |      |      |      |      |      |      |      |
            // |       |      |      |       |       |             |      |      |      |      |      |      |      |      |      |      |      |      |      |

            bindings = <
            &bt BT_CLR &bt BT_SEL 0 &bt BT_SEL 1 &bt BT_SEL 2 &bt BT_SEL 3                                                                           &bt BT_SEL 3 &bt BT_SEL 2 &bt BT_SEL 1 &bt BT_SEL 0 &bt BT_CLR
            &kp F1     &kp F2       &kp F3       &kp F4       &kp F5       &kp F6                                                           &kp F6   &kp F7       &kp F8       &kp F9       &kp F10      &kp F11
            &kp N1     &kp N2       &kp N3       &kp N4       &kp N5       &kp N6                                                           &kp N6   &kp N7       &kp N8       &kp N9       &kp N0       &kp F12
            &kp Q      &kp W        &kp E        &kp R        &kp T        &kp Y                                                            &kp Y    &kp U        &kp I        &kp O        &kp P        &kp BSPC
            &kp A      &kp S        &kp D        &kp F        &kp G        &kp H        &kp LSHFT &kp LCTRL &none        &none &kp RCTRL &kp RSHFT &kp H   &kp J        &kp K        &kp L        &kp SEMI     &kp SQT
            &kp Z      &kp X        &kp C        &kp V        &kp B                     &kp SPACE &kp RET   &none        &none &kp RET   &kp SPACE         &kp N        &kp M        &kp COMMA    &kp DOT      &kp FSLH
            >;
        };
    };
};
